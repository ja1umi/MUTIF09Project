*	MPB6809 MONITOR
*	   20101123
*
*	L  LOAD
*	G  GO TO TARGET PROGRAM
*	M  MEMORY CHANGE
*	P  PUNCH DUMP
*	R  DISPLAY CONTENTS OF TARGET STACK
*	D  MEMORY DUMP
*	F  FILL
*	C  CONTINUE FROM BREAKPOINT
*
ACIACS	EQU	$B000
ACIADA	EQU	ACIACS+1
	ORG	$F000

*     I/O INTERRUPT SEQUENCE
IO	LDX	IOV
	JMP	,X

* NMI SEQUENCE
POWDWN	LDX	NIO			; GET NMI VECTOR
	JMP	,X

**
INZACI	LDX	#ACIACS
	LDA	#3
	STA	,X
*	LDA	#$15
	LDA	#$95
	STA	,X
	RTS
**
* INPUT HEX CHAR
INHEX	LBSR	INCH
INHEX2	CMPA	#$30
	BMI	LOAD19			; NOT HEX
	CMPA	#$39
	BLE	IN1HG
	CMPA	#$41
	BMI	LOAD19			; NOT HEX
	CMPA	#$46
	BGT	LOAD19			; NOT HEX
	SUBA	#7
IN1HG	RTS
**
LOAD	NOP
* LOAD	INC	OUTSW
LOAD3	LBSR	INCH
	CMPA	#'S
	BNE	LOAD3
	LBSR	INCH
	CMPA	#'9
	BEQ	C1
	CMPA	#'1
	BNE	LOAD3
	CLR	CKSM
	BSR	BYTE
	SUBA	#2
	STA	BYTECT
* BUILD ADDRESS
	BSR	BADDR
* STORE DATA
LOAD11	BSR	BYTE
	DEC	BYTECT
	BEQ	LOAD15
	STA	,X
	CMPA	,X
	BNE	LOAD19
	LEAX	1,X
	BRA	LOAD11
LOAD15	INC	CKSM
	BEQ	LOAD3
LOAD19	LDA	#'?
	LBSR	OUTCH
C1	LBRA	CONTRL	
**
* BUILD ADDRESS
BADDR	BSR	BYTE		; READ 2 FRAMES
	STA	XHI
	BSR	BYTE
	STA	XLOW
	LDX	XHI				; (X) ADDRESS WE BUILT
	RTS
**
* INPUT BYTE (TWO FRAMES)
BYTE	BSR	INHEX
BYTE2	ASLA
	ASLA
	ASLA
	ASLA
	TFR	A,B
	BSR	INHEX
	ANDA	#$0F
	PSHS	B
	ADDA	,S+
	TFR	A,B
	ADDB	CKSM
	STB	CKSM
	RTS
**
* CHANGE MEMORY (M AAAA DD NN)
CHANGE	BSR	BADDR		; BUILD ADDRESS
	BSR	OUTS
CHANG	LDX	XHI
	BSR	OUT2HS			; PRINT DATA (OLD)
	LEAX	-1,X
CHA1	BSR	INCH
	CMPA	#$0D
	BEQ	LF
	CMPA	#$5E		; (^)
	BEQ	VA
	LBSR	INHEX2
	BSR	BYTE2
	STA	,X
	CMPA	,X
	BNE	LOAD19
	BRA	CHA1
LF	LEAX	1,X
	BRA	VA1
VA	LEAX	-1,X
VA1	STX	XHI
	LDX	#MCL
	BSR	PSTR
	LDX	#XHI
	BSR	OUT4HS
	BRA	CHANG
**
*  INPUT ONE CHAR *
INCH	LDA	ACIACS
	ASRA
	BCC	INCH
	LDA	ACIADA
	BEQ	INCH
	TST	OUTSW
	BEQ	OUTCH
	RTS

* OUT HEX LEFT BCD DIGIT
OUTHL	LSRA
	LSRA
	LSRA
	LSRA
* OUT HEX RIGHT BCD DIGIT
OUTHR	ANDA	#$0F
	ADDA	#$30
	CMPA	#$39
	BLS	OUTCH
	ADDA	#7

* OUTPUT ONE CHAR
OUTCH	PSHS	B
OUTCH1	LDB	ACIACS
	BITB	#2
	BEQ	OUTCH1
	STA	ACIADA
	PULS	B,PC
**
* OUTPUT 2 HEX CHAR
OUT2H	LDA	,X
	BSR	OUTHL
	LDA	,X
	BSR	OUTHR
	LEAX	1,X
	RTS
**
OUT4HS	BSR	OUT2H		; OUTPUT 4 HEX CHAR + SPACE
OUT2HS	BSR	OUT2H		; OUTPUT 2 HEX CHAR + SPACE
OUTS	LDA	#$20		; SPACE
	BRA	OUTCH			; (BSR & RTS)
**
* PRINT STRING POINTED AT BY X-REG *
* TERMINATOR=00
PSTR	LDA	,X+
	CMPA	#0
	BEQ	PSTR1
	LBSR	OUTCH
	BRA	PSTR
PSTR1	RTS
**
GETADD	LBSR	BADDR
	STX	BEGA
	BSR	OUTS
	LBSR	BADDR
	STX	ENDA
	RTS
**


* ENTER POWER  ON SEQUENCE
START	EQU	*
	LDS	#STACK
	STS	SP				; INZ TARGET'S STACK PNTR
	LBSR	INZACI
	LDX	#STACK
	LDB	#12
	CLRA
CL	STA	,X+
	DECB
	BNE	CL
	LDX	#LOGO
	LBSR	PSTR
CONTRL	LDS	#STACK		; SET CONTRL STACK POINTER
	CLR	OUTSW
	LDX	#MCL
	BSR	PSTR			; PRINT DATA STRING
	LBSR	INCH		; READ CHARACTER
	TFR	A,B
	BSR	OUTS			; PRINT SPACE
	CMPB	#'L
	BNE	*+5
	LBRA	LOAD
	CMPB	#'M
	LBEQ	CHANGE
	CMPB	#'R
	BEQ	PRINT			; STACK
	CMPB	#'P
	LBEQ	PUNCH		; PRINT/PUNCH
	CMPB	#'C
	BEQ	CONT
	CMPB	#'D
	BEQ	DUMP
	CMPB	#'F
	LBEQ	FILL
	CMPB	#'G
	BNE	CONTRL
	LBSR	BADDR
	STX	10,S
	LDA	,S
	ORA	#$80
	STA	,S
	RTI					; GO
**
* ENTER FROM SOFTWARE INTERRUPT 2
SFE2	EQU	*
	STS	SP				; SAVE TARGET'S STACK POINTER
	BRA	PRINT
**
* ENTER FROM SOFTWARE INTERRUPT
SFE	EQU	*
	STS	SP				; SAVE TARGET'S STACK POINTER
* DECREMENT P-COUNTER
	TFR	S,X
	TST	11,X
	BNE	*+4
	DEC	10,X
	DEC	11,X

* PRINT CONTENTS OF STACK
PRINT	LDX	#RHDR
	LBSR	PSTR
	LDX	SP
	LBSR	OUT2HS		; CONDITION CODES
	LBSR	OUT2HS		; ACC-A
	LBSR	OUT2HS		; ACC-B
	LBSR	OUT2HS		; DP
	LBSR	OUT4HS		; X-REG
	LBSR	OUT4HS		; Y-REG
	LBSR	OUT4HS		; U-STACK
	LBSR	OUT4HS		; P-COUNTER
	LDX	#SP
	LBSR	OUT4HS		; STACK POINTER
	LBRA    CONTRL

**
CONT	LDS	SP			; RESTORE PGM'S STACK PTR
	RTI					; GO
**
DUMP	LBSR	GETADD
	LDX	#DHDR
	LBSR	PSTR
	LDA	#$F0
	ANDA	BEGA+1
	STA	BEGA+1
	LDX	BEGA
	STX	TW
	LDA	#$0F
	ORA	ENDA+1
	STA	ENDA+1
DUM11	LDB	#$10
	LDX	#TW
	LBSR	OUT2H
	LBSR	OUT2H
	LDX	TW
DUM32	LDA	#$20
	LBSR	OUTCH
	LBSR	OUT2H
	DECB
	BNE	DUM32
	LDA	#$20
	LBSR	OUTCH
	LDB	#$10
	LDX	TW
DUM42	LDA	,X+
	CMPA	#$80
	BCC	PDOT
	CMPA	#$7F
	BEQ	PDOT
	CMPA	#$20
	BMI	PDOT
	BRA	PASCI
PDOT	LDA	#$2E
PASCI	LBSR	OUTCH
	DECB
	BNE	DUM42
	STX	TW
	LDX	#CRLF
	LBSR	PSTR
	LDX	TW
	LEAX	-1,X
	CMPX	ENDA
	BNE	DUM11
	LBRA	CONTRL
**
FILL	LBSR	GETADD
	LBSR	OUTS
	LBSR	BYTE
	LDX	ENDA
	LEAX	1,X
	STX	ENDA
	LDX	BEGA
FILL2	STA	,X+
	CMPX	ENDA
	BNE	FILL2
	LBRA	CONTRL
**		
* PUNCH DUMP
* PUNCH FROM BEGINING ADDRESS (BEGA) THRU ENDING
* ADDRESS (ENDA)
*
MTAPE1	FCB	$D,$A,'S,'1,0	; PUNCH FORMAT
MCL	FCB	$D,$A,'*,0	C/R,L/F
MEOF	FCB	$D,$A,'S,'9,0
RHDR	FCB	$D,$A
	FCC	/CC  A  B DP    X    Y   UP   PC   SP/
CRLF	FCB	$D,$A,0
DHDR	FCB	$D,$A
	FCC	/     +0 +1 +2 +3 +4 +5 +6 +7 +8 +9 +A +B +C +D +E +F       ASCII/
	FCB	$D,$A,0
LOGO	FCB	$D,$A
	FCC	/*** MPB6809 monitor ver1.00 ***/
	FCB	$D,$A
	FCC	/Ported to MUTIF09 6809 Single Board Computer/
	FCB	$D,$A,0
**
PUNCH	EQU	*
	LBSR	GETADD
	LDX	BEGA
	STX	TW				; TEMP BEGINING ADDRESS
PUN11	LDA	ENDA+1
	SUBA	TW+1
	LDB	ENDA
	SUBB	TW
	BNE	PUN22
	CMPA	#16
	BCS	PUN23
PUN22	LDA	#15
PUN23	ADDA	#4
	STA	MCONT
	SUBA	#3
	STA	TEMP
* PUNCH C/R,L/F,S,1
	LDX	#MTAPE1
	LBSR	PSTR
	CLRB
* PUNCH FRAME COUNT
	LDX	#MCONT
	BSR	PUNT2
* PUNCH ADDRESS
	LDX	#TW
	BSR	PUNT2
	BSR	PUNT2
* PUNCH DATA
	LDX	TW
PUN32	BSR	PUNT2		; PUNCH ONE BYTE (2 FRAMES)
	DEC	TEMP			; DEC BYTE COUNT
	BNE	PUN32
	STX	TW
	COMB
	PSHS	B
	TFR	S,X
	BSR	PUNT2			; PUNCH CHECKSUM
	PULS	B
	LDX	TW
	LEAX	-1,X
	CMPX	ENDA
	BNE	PUN11
	LDX	#MEOF
	LBSR	PSTR
	LBRA	CONTRL
* PUNCH 2 HEX CHAR UPDATE CHECKSUM
PUNT2	ADDB	,X
	LBRA	OUT2H
**
	ORG	$FFF4
	FDB	SFE2
	FDB	IO
	FDB	IO
	FDB	SFE
	FDB	POWDWN
	FDB	START
**

*	ORG	$DF80
	ORG	$7F80
IOV	RMB	2				; IO INTERRUPT POINTER
BEGA	RMB	2			; BEGINING ADDR PRINT/PUNCH
ENDA	RMB	2			; ENDING ADDR PRINT/PUNCH
NIO	RMB	2				; NMI INTERRUPT POINTER
CKSM	RMB	1			; CHECKSUM
BYTECT	RMB	1			; BYTE COUNT
XHI	RMB	1				; XREG HIGH
XLOW	RMB	1			; XREG LOW
TEMP	RMB	1			; CHAR COUNT (INADD)
TW	RMB	2				; TEMP/
MCONT	RMB	1			; TEMP
OUTSW	RMB	1
	RMB	46
* REGISTERS FOR GO
STACK	RMB	1			; CONDITION CODES
	RMB	1				; ACC-A
	RMB	1				; ACC-B
	RMB	1				; DP
	RMB	2				; X-REG
	RMB	2				; Y-REG
	RMB	2				; U-STACK
	RMB	2				; P-COUNTER
SP	RMB	1				; S-HIGH
	RMB	1				; S-LOW
* END REGISTERS FOR GO
	END

